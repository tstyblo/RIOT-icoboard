## boards/icosoc/Kconfig
```kconfig
# Copyright (c) 2020 Tomas Styblo
#
# This file is subject to the terms and conditions of the GNU Lesser
# General Public License v2.1. See the file LICENSE in the top level
# directory for more details.
#

# TODO - do not use this file - not ready

config BOARD
    default "icosoc" if BOARD_ICOSOC

config BOARD_ICOSOC
    bool
    default y
    select CPU_MODEL_PICORV32
```

## cpu/picorv32/Kconfig
```kconfig
# Copyright (c) 2020 Inria
# Copyright (c) 2020 Tomas Styblo
#
# This file is subject to the terms and conditions of the GNU Lesser
# General Public License v2.1. See the file LICENSE in the top level
# directory for more details.
#

# TODO - do not use this file - not ready

config CPU_ARCH_RISCV
    bool
    select HAS_ARCH_RISCV
    select HAS_PERIPH_GPIO
    select HAS_PERIPH_PM
    select HAS_CPP
    select HAS_LIBSTDCPP

## Definition of specific features
config HAS_ARCH_RISCV
    bool
    help
        Indicates that the current CPU has a RISC-V.

## Definition of specific features
config CPU_ARCH
    default "risc-v" if CPU_ARCH_RISCV

config CPU_MODEL
    default "picorv32"  if CPU_MODEL_PICORV32

config CPU
    default "picorv32" if CPU_MODEL_PICORV32
```
